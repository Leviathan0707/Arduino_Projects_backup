//https://www.arduino.cc/reference/en/language/functions/usb/keyboard/keyboardmodifiers/
#include <Wire.h>
#include <Adafruit_GFX.h>
#include <Adafruit_SSD1306.h>
#include <Keyboard.h>
#include <Mouse.h>

#define SCREEN_WIDTH 128 // OLED display width, in pixels
#define SCREEN_HEIGHT 64 // OLED display height, in pixels

#define OLED_RESET 4
Adafruit_SSD1306 display(SCREEN_WIDTH, SCREEN_HEIGHT, &Wire, OLED_RESET);

#define LOGO_HEIGHT   64
#define LOGO_WIDTH    128

// 'arduino-logo-1 - Copy', 128x64px
const unsigned char arduino_logo [] PROGMEM = {
  0x00, 0x00, 0x00, 0x00, 0x00, 0x00, 0x00, 0x00, 0x00, 0x00, 0x00, 0x00, 0x00, 0x00, 0x00, 0x00, 
  0x00, 0x00, 0x00, 0x3f, 0xfe, 0x00, 0x00, 0x00, 0x00, 0x00, 0x00, 0x3f, 0xfc, 0x00, 0x00, 0x00, 
  0x00, 0x00, 0x03, 0xff, 0xff, 0xe0, 0x00, 0x00, 0x00, 0x00, 0x03, 0xff, 0xff, 0xc0, 0x00, 0x00, 
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  0x00, 0x00, 0x00, 0x00, 0x00, 0x00, 0x00, 0x00, 0x00, 0x00, 0x00, 0x00, 0x00, 0x00, 0x00, 0x00
};

// 'Word-icon', 128x64px
const unsigned char WORD_logo [] PROGMEM = {
  0x00, 0x00, 0x00, 0x00, 0x00, 0x00, 0x00, 0x00, 0x7c, 0x00, 0x00, 0x00, 0x00, 0x00, 0x00, 0x00, 
  0x00, 0x00, 0x00, 0x00, 0x00, 0x00, 0x00, 0x3f, 0xfc, 0x00, 0x00, 0x00, 0x00, 0x00, 0x00, 0x00, 
  0x00, 0x00, 0x00, 0x00, 0x00, 0x00, 0x07, 0xff, 0xfc, 0x00, 0x00, 0x00, 0x00, 0x00, 0x00, 0x00, 
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  0x00, 0x00, 0x00, 0x00, 0x00, 0x00, 0x00, 0x00, 0xfc, 0x00, 0x00, 0x00, 0x00, 0x00, 0x00, 0x00
};

// 'Excel-icon', 128x64px
const unsigned char EXCELL_logo [] PROGMEM = {
  0x00, 0x00, 0x00, 0x00, 0x00, 0x00, 0x00, 0x00, 0x18, 0x00, 0x00, 0x00, 0x00, 0x00, 0x00, 0x00, 
  0x00, 0x00, 0x00, 0x00, 0x00, 0x00, 0x00, 0x07, 0xf8, 0x00, 0x00, 0x00, 0x00, 0x00, 0x00, 0x00, 
  0x00, 0x00, 0x00, 0x00, 0x00, 0x00, 0x00, 0xff, 0xf8, 0x00, 0x00, 0x00, 0x00, 0x00, 0x00, 0x00, 
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  0x00, 0x00, 0x00, 0x00, 0x00, 0x00, 0x00, 0x00, 0x78, 0x00, 0x00, 0x00, 0x00, 0x00, 0x00, 0x00
};


// 'PowerPoint-icon', 128x64px
const unsigned char POWERPOINT_logo [] PROGMEM = {
  0x00, 0x00, 0x00, 0x00, 0x00, 0x00, 0x00, 0x00, 0x7c, 0x00, 0x00, 0x00, 0x00, 0x00, 0x00, 0x00, 
  0x00, 0x00, 0x00, 0x00, 0x00, 0x00, 0x00, 0x0f, 0xfc, 0x00, 0x00, 0x00, 0x00, 0x00, 0x00, 0x00, 
  0x00, 0x00, 0x00, 0x00, 0x00, 0x00, 0x03, 0xff, 0xfc, 0x00, 0x00, 0x00, 0x00, 0x00, 0x00, 0x00, 
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  0x00, 0x00, 0x00, 0x00, 0x00, 0x00, 0x00, 0x03, 0xfc, 0x00, 0x00, 0x00, 0x00, 0x00, 0x00, 0x00
};

// 'a5970e2a977f9db1f8fc012508bc69e5', 128x64px
const unsigned char sifu_logo [] PROGMEM = {
  0x00, 0x00, 0x00, 0x00, 0x00, 0x00, 0x00, 0x00, 0x00, 0x00, 0x00, 0x00, 0x00, 0x00, 0x00, 0x00, 
  0x00, 0x00, 0x00, 0x00, 0x00, 0x00, 0x06, 0x00, 0x00, 0x00, 0x00, 0x00, 0x00, 0x00, 0x00, 0x00, 
  0x00, 0x00, 0x00, 0x00, 0x00, 0x00, 0x1c, 0x00, 0x00, 0x00, 0x00, 0x00, 0x00, 0x00, 0x00, 0x00, 
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  0x00, 0x00, 0x00, 0x00, 0x00, 0x00, 0x00, 0x00, 0x00, 0x00, 0x00, 0x00, 0x00, 0x00, 0x00, 0x00
};

const int encoder1A = 8; //DT
const int encoder1B = 7; //CLK
const int encoder1C = 6;
const int encoder2A = 14;//DT
const int encoder2B = 16;//CLK
const int encoder2C = 10;

const int red_button = 9;

int buttonStateEncoder1 = 0;         
int lastButtonStateEncoder1 = 0; 
int currentState1B;
int previousState1B;
int counter1 = 0;

int buttonStateEncoder2 = 0;         
int lastButtonStateEncoder2 = 0; 
int currentState2B;
int previousState2B;
int counter2 = 0;

unsigned long previousMillisOLED = 0; 
const long OledOnTime = 7000;  

//____________________________experimental___________________________
long TimeOfLastDebounce = 0;
int DelayofDebounce = 10;

int PreviousCLK;   
int PreviousDATA;

int displaycounter=0; // Store current counter value
//___________________________________________________________________

void setup() {
  Serial.begin(9600);
  pinMode(encoder1A, INPUT_PULLUP);
  pinMode(encoder1B, INPUT_PULLUP);
  pinMode(encoder1C, INPUT_PULLUP);
  pinMode(encoder2A, INPUT_PULLUP);
  pinMode(encoder2B, INPUT_PULLUP);
  pinMode(encoder2C, INPUT_PULLUP);
  pinMode(red_button, INPUT_PULLUP);

  previousState1B = digitalRead(encoder1B);
  previousState2B = digitalRead(encoder2B);

//_______________experimental______________________________________

 PreviousCLK=digitalRead(encoder1B);
 PreviousDATA=digitalRead(encoder1A);
//_________________________________________________________________  

//OLED______________________________________________________________________________
  if(!display.begin(SSD1306_SWITCHCAPVCC, 0x3C)) { // Address 0x3D for 128x64
    Serial.println(F("SSD1306 allocation failed"));
    for(;;); // Don't proceed, loop forever
  }
}

void loop() {
unsigned long currentMillis = millis();
if (currentMillis - previousMillisOLED >= OledOnTime) {
 display.ssd1306_command(SSD1306_DISPLAYOFF);
 previousMillisOLED = currentMillis;
}
//Serial.printlnln(currentMillis - previousMillisOLED);

if (!digitalRead(red_button)) {                                       //task manager
    Keyboard.press(KEY_LEFT_CTRL);
    Keyboard.press(KEY_LEFT_SHIFT);
    Keyboard.press(KEY_ESC);
    Keyboard.releaseAll();
    delay(50);
  }
  
  buttonStateEncoder1 = digitalRead(encoder1C);
  if (buttonStateEncoder1 != lastButtonStateEncoder1) {
    if (buttonStateEncoder1 == LOW) {
      Mouse.press(MOUSE_LEFT);
      } 
    }
    else {Mouse.release(MOUSE_LEFT);}
  lastButtonStateEncoder1 = buttonStateEncoder1;

buttonStateEncoder2 = digitalRead(encoder2C);
  if (buttonStateEncoder2 != lastButtonStateEncoder2) {
    if (buttonStateEncoder2 == LOW) {Mouse.press(MOUSE_RIGHT);}
    else {Mouse.release(MOUSE_RIGHT);}
  }
  lastButtonStateEncoder2 = buttonStateEncoder2;





//_____________isolated______________________________________
//currentState1B = digitalRead(encoder1B);
//  if (currentState1B != previousState1B) {rotaryEncoder1();}
//_____________________________________________________________

//EXPERIMENTAL_________________________________________________________________
if ((millis() - TimeOfLastDebounce) > DelayofDebounce) {
    
    check_rotary();  // Rotary Encoder check routine below
    
    PreviousCLK  = digitalRead(encoder1B);
    PreviousDATA = digitalRead(encoder1A);
    
    TimeOfLastDebounce=millis();  // Set variable to current millis() timer
  }
//_______________________________________________________________________________


  
currentState2B = digitalRead(encoder2B);
  if (currentState2B != previousState2B) {
    {
  if (digitalRead(encoder2A) != currentState2B) {
      counter2 --;
    }
    else {
      counter2 ++;
    }
    if (counter2 <= 0){counter2 = 4;}
    if (counter2 > 4){counter2 = 0;}
    Serial.println(counter2);
    display.ssd1306_command(SSD1306_DISPLAYON);
    previousMillisOLED = currentMillis;
    previousState2B = currentState2B;   
}
    }
//OLED______________________________________________________________

if (counter2 == 0){testdrawbitmap_ARDUINO();}
if (counter2 == 1){testdrawbitmap_SIFU();}
if (counter2 == 2){testdrawbitmap_POWERPOINT();}
if (counter2 == 3){testdrawbitmap_EXCELL();}
if (counter2 == 4){testdrawbitmap_WORD();}
}

//void rotaryEncoder1(){
//  if (digitalRead(encoder1A) != currentState1B) {
//      counter1 --;
//    }
//    else {
//      counter1 ++;
//    }
//    Serial.printlnln(counter1);
//    previousState1B = currentState1B;   
//}

//void rotaryEncoder2(){
//  if (digitalRead(encoder2A) != currentState2B) {
//      counter2 --;
//    }
//    else {
//      counter2 ++;
//    }
//    if (counter2 <= 0){counter2 = 4;}
//    if (counter2 > 4){counter2 = 0;}
//    Serial.printlnln(counter2);
//    display.ssd1306_command(SSD1306_DISPLAYON);
//
//    previousState2B = currentState2B;   
//}

//_______________________EXPERIMENTAL_____________________________________________________________________________
void check_rotary() {

 if ((PreviousCLK == 0) && (PreviousDATA == 1)) {
    if ((digitalRead(encoder1B) == 1) && (digitalRead(encoder1A) == 0)) {
      displaycounter++;
      Serial.println(displaycounter);
    }
    if ((digitalRead(encoder1B) == 1) && (digitalRead(encoder1A) == 1)) {
      displaycounter--;
      Serial.println(displaycounter);
    }
  }

if ((PreviousCLK == 1) && (PreviousDATA == 0)) {
    if ((digitalRead(encoder1B) == 0) && (digitalRead(encoder1A) == 1)) {
      displaycounter++;
      Serial.println(displaycounter);
    }
    if ((digitalRead(encoder1B) == 0) && (digitalRead(encoder1A) == 0)) {
      displaycounter--;
      Serial.println(displaycounter);
    }
  }

if ((PreviousCLK == 1) && (PreviousDATA == 1)) {
    if ((digitalRead(encoder1B) == 0) && (digitalRead(encoder1A) == 1)) {
      displaycounter++;
      Serial.println(displaycounter);
    }
    if ((digitalRead(encoder1B) == 0) && (digitalRead(encoder1A) == 0)) {
      displaycounter--;
      Serial.println(displaycounter);
    }
  }  

if ((PreviousCLK == 0) && (PreviousDATA == 0)) {
    if ((digitalRead(encoder1B) == 1) && (digitalRead(encoder1A) == 0)) {
      displaycounter++;
      Serial.println(displaycounter);
    }
    if ((digitalRead(encoder1B) == 1) && (digitalRead(encoder1A) == 1)) {
      displaycounter--;
          Serial.println(displaycounter);
    }
  }            
 }
//________________________________________________________________________________________________________________



//bitmap function________________________________________________________________________________________________
void testdrawbitmap_ARDUINO(void) {  
display.clearDisplay();
display.drawBitmap(
(display.width()  - LOGO_WIDTH ) / 2,
(display.height() - LOGO_HEIGHT) / 2,
arduino_logo, LOGO_WIDTH, LOGO_HEIGHT, 1);
display.display();             
}

void testdrawbitmap_SIFU(void) {  
display.clearDisplay();
display.drawBitmap(
(display.width()  - LOGO_WIDTH ) / 2,
(display.height() - LOGO_HEIGHT) / 2,
sifu_logo, LOGO_WIDTH, LOGO_HEIGHT, 1);
display.display();                                                    
}

void testdrawbitmap_WORD(void) {  
display.clearDisplay();
display.drawBitmap(
(display.width()  - LOGO_WIDTH ) / 2,
(display.height() - LOGO_HEIGHT) / 2,
WORD_logo, LOGO_WIDTH, LOGO_HEIGHT, 1);
display.display();                                                    
}

void testdrawbitmap_EXCELL(void) {  
display.clearDisplay();
display.drawBitmap(
(display.width()  - LOGO_WIDTH ) / 2,
(display.height() - LOGO_HEIGHT) / 2,
EXCELL_logo, LOGO_WIDTH, LOGO_HEIGHT, 1);
display.display();                                                    
}

void testdrawbitmap_POWERPOINT(void) {  
display.clearDisplay();
display.drawBitmap(
(display.width()  - LOGO_WIDTH ) / 2,
(display.height() - LOGO_HEIGHT) / 2,
POWERPOINT_logo, LOGO_WIDTH, LOGO_HEIGHT, 1);
display.display();                                                    
}
//___________________________________________________________________________________________
