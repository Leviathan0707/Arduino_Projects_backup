//https://www.arduino.cc/reference/en/language/functions/usb/keyboard/keyboardmodifiers/
#include <Wire.h>
#include <Adafruit_GFX.h>
#include <Adafruit_SSD1306.h>
#include <Keyboard.h>
#include <Mouse.h>

//_____________EEPROM__________________
#include <AT24Cxx.h>
#define i2c_address 0x50
AT24Cxx eep(i2c_address, 32);
//_____________________________________

#define SCREEN_WIDTH 128 // OLED display width, in pixels
#define SCREEN_HEIGHT 64 // OLED display height, in pixels

#define OLED_RESET 4
Adafruit_SSD1306 display(SCREEN_WIDTH, SCREEN_HEIGHT, &Wire, OLED_RESET);

#define LOGO_HEIGHT   64
#define LOGO_WIDTH    128

// 'arduino-logo-1 - Copy', 128x64px
const unsigned char arduino_logo [] PROGMEM = {
  0x00, 0x00, 0x00, 0x00, 0x00, 0x00, 0x00, 0x00, 0x00, 0x00, 0x00, 0x00, 0x00, 0x00, 0x00, 0x00,
  0x00, 0x00, 0x00, 0x3f, 0xfe, 0x00, 0x00, 0x00, 0x00, 0x00, 0x00, 0x3f, 0xfc, 0x00, 0x00, 0x00,
  0x00, 0x00, 0x03, 0xff, 0xff, 0xe0, 0x00, 0x00, 0x00, 0x00, 0x03, 0xff, 0xff, 0xc0, 0x00, 0x00,
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  0x00, 0x00, 0x00, 0x00, 0x00, 0x00, 0x00, 0x00, 0x00, 0x00, 0x00, 0x00, 0x00, 0x00, 0x00, 0x00
};

// 'Word-icon', 128x64px
const unsigned char WORD_logo [] PROGMEM = {
  0x00, 0x00, 0x00, 0x00, 0x00, 0x00, 0x00, 0x00, 0x7c, 0x00, 0x00, 0x00, 0x00, 0x00, 0x00, 0x00,
  0x00, 0x00, 0x00, 0x00, 0x00, 0x00, 0x00, 0x3f, 0xfc, 0x00, 0x00, 0x00, 0x00, 0x00, 0x00, 0x00,
  0x00, 0x00, 0x00, 0x00, 0x00, 0x00, 0x07, 0xff, 0xfc, 0x00, 0x00, 0x00, 0x00, 0x00, 0x00, 0x00,
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  0x00, 0x00, 0x00, 0x00, 0x00, 0x00, 0x00, 0x00, 0xfc, 0x00, 0x00, 0x00, 0x00, 0x00, 0x00, 0x00
};

// 'Excel-icon', 128x64px
const unsigned char EXCELL_logo [] PROGMEM = {
  0x00, 0x00, 0x00, 0x00, 0x00, 0x00, 0x00, 0x00, 0x18, 0x00, 0x00, 0x00, 0x00, 0x00, 0x00, 0x00,
  0x00, 0x00, 0x00, 0x00, 0x00, 0x00, 0x00, 0x07, 0xf8, 0x00, 0x00, 0x00, 0x00, 0x00, 0x00, 0x00,
  0x00, 0x00, 0x00, 0x00, 0x00, 0x00, 0x00, 0xff, 0xf8, 0x00, 0x00, 0x00, 0x00, 0x00, 0x00, 0x00,
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  0x00, 0x00, 0x00, 0x00, 0x00, 0x00, 0x00, 0x00, 0x78, 0x00, 0x00, 0x00, 0x00, 0x00, 0x00, 0x00
};


// 'PowerPoint-icon', 128x64px
const unsigned char POWERPOINT_logo [] PROGMEM = {
  0x00, 0x00, 0x00, 0x00, 0x00, 0x00, 0x00, 0x00, 0x7c, 0x00, 0x00, 0x00, 0x00, 0x00, 0x00, 0x00,
  0x00, 0x00, 0x00, 0x00, 0x00, 0x00, 0x00, 0x0f, 0xfc, 0x00, 0x00, 0x00, 0x00, 0x00, 0x00, 0x00,
  0x00, 0x00, 0x00, 0x00, 0x00, 0x00, 0x03, 0xff, 0xfc, 0x00, 0x00, 0x00, 0x00, 0x00, 0x00, 0x00,
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  0x00, 0x00, 0x00, 0x00, 0x00, 0x00, 0x00, 0x03, 0xfc, 0x00, 0x00, 0x00, 0x00, 0x00, 0x00, 0x00
};

// 'a5970e2a977f9db1f8fc012508bc69e5', 128x64px
const unsigned char sifu_logo [] PROGMEM = {
  0x00, 0x00, 0x00, 0x00, 0x00, 0x00, 0x00, 0x00, 0x00, 0x00, 0x00, 0x00, 0x00, 0x00, 0x00, 0x00,
  0x00, 0x00, 0x00, 0x00, 0x00, 0x00, 0x06, 0x00, 0x00, 0x00, 0x00, 0x00, 0x00, 0x00, 0x00, 0x00,
  0x00, 0x00, 0x00, 0x00, 0x00, 0x00, 0x1c, 0x00, 0x00, 0x00, 0x00, 0x00, 0x00, 0x00, 0x00, 0x00,
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  0x00, 0x00, 0x00, 0x00, 0x00, 0x00, 0x00, 0x00, 0x00, 0x00, 0x00, 0x00, 0x00, 0x00, 0x00, 0x00
};

// 'valorant-logo-FAB2CA0E55-seeklogo', 128x64px
const unsigned char VALORANT_logo [] PROGMEM = {
  0x00, 0x00, 0x00, 0x00, 0x00, 0x00, 0x00, 0x00, 0x00, 0x00, 0x00, 0x00, 0x00, 0x00, 0x00, 0x00,
  0x00, 0x00, 0x00, 0x00, 0x00, 0xc0, 0x00, 0x00, 0x00, 0x00, 0x00, 0xc0, 0x00, 0x00, 0x00, 0x00,
  0x00, 0x00, 0x00, 0x00, 0x00, 0xe0, 0x00, 0x00, 0x00, 0x00, 0x01, 0xc0, 0x00, 0x00, 0x00, 0x00,
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  0x00, 0x01, 0xe3, 0xc0, 0xf3, 0xfc, 0x3f, 0xc1, 0xc1, 0xe7, 0x83, 0xe0, 0x78, 0x38, 0x00, 0x00
};

// '40-407952_ubisoft-logo-png-far-cry-4-title', 128x64px
const unsigned char FARCRY4_logo [] PROGMEM = {
  0x00, 0x00, 0x00, 0x00, 0x00, 0x00, 0x00, 0x00, 0x00, 0x00, 0x00, 0x00, 0x00, 0x00, 0x00, 0x00,
  0x00, 0x00, 0x00, 0x00, 0x00, 0x00, 0x00, 0x00, 0x00, 0x00, 0x00, 0x00, 0x00, 0x00, 0x00, 0x00,
  0x00, 0x00, 0x00, 0x00, 0x00, 0x00, 0x00, 0x00, 0x00, 0x00, 0x00, 0x00, 0x00, 0x00, 0x00, 0x00,
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  0x00, 0x00, 0x00, 0x00, 0x00, 0x00, 0x00, 0x00, 0x00, 0x00, 0x00, 0x00, 0x00, 0x00, 0x00, 0x00
};


const int encoder1A = 8; //DT
const int encoder1B = 7; //CLK
const int encoder1C = 6;
const int encoder2A = 14;//DT
const int encoder2B = 16;//CLK
const int encoder2C = 10;

const int red_button = 9;

int buttonStateEncoder1 = 0;
int lastButtonStateEncoder1 = 0;
int currentState1B;
int previousState1B;
int counter1 = 0;

int buttonStateEncoder2 = 0;
int lastButtonStateEncoder2 = 0;
int currentState2B;
int previousState2B;
int counter2 = 0;
int profileGroup = 0;
unsigned long previousMillisOLED = 0;
const long OledOnTime = 7000;

void setup() {
  Serial.begin(9600);
  pinMode(encoder1A, INPUT_PULLUP);
  pinMode(encoder1B, INPUT_PULLUP);
  pinMode(encoder1C, INPUT_PULLUP);
  pinMode(encoder2A, INPUT_PULLUP);
  pinMode(encoder2B, INPUT_PULLUP);
  pinMode(encoder2C, INPUT_PULLUP);
  pinMode(red_button, INPUT_PULLUP);

  previousState1B = digitalRead(encoder1B);
  previousState2B = digitalRead(encoder2B);

//test EEPROM read____________________________________________________________________
//for (int arduino_loop = 0; arduino_loop <= 1023; arduino_loop++){
//  arduino_logo [arduino_loop] = eep.read(arduino_loop);
//}
//

//____________________________________________________________________________________

  //OLED______________________________________________________________________________
  if (!display.begin(SSD1306_SWITCHCAPVCC, 0x3C)) { // Address 0x3D for 128x64
    Serial.println(F("SSD1306 allocation failed"));
    for (;;); // Don't proceed, loop forever
  }
}

void loop() {
  unsigned long currentMillis = millis();
  if (currentMillis - previousMillisOLED >= OledOnTime) {
    display.ssd1306_command(SSD1306_DISPLAYOFF);
    previousMillisOLED = currentMillis;
  }

  buttonStateEncoder1 = digitalRead(encoder1C);
  if (buttonStateEncoder1 != lastButtonStateEncoder1) {
    if (buttonStateEncoder1 == LOW) {
      Mouse.press(MOUSE_LEFT);
    }
  }
  else {
    Mouse.release(MOUSE_LEFT);
  }
  lastButtonStateEncoder1 = buttonStateEncoder1;

  buttonStateEncoder2 = digitalRead(encoder2C);
  if (buttonStateEncoder2 != lastButtonStateEncoder2) {
    if (buttonStateEncoder2 == LOW) {

      if (profileGroup == 0) {
        profileGroup = 1;
      }
      else {
        profileGroup = 0;
      }
    }
    else {
      Mouse.release(MOUSE_RIGHT);
    }
  }
  lastButtonStateEncoder2 = buttonStateEncoder2;

//if (!digitalRead(encoder2C)){
//  if (profileGroup == 0) {
//        profileGroup = 1;
//      }
//      else {
//        profileGroup = 0;
//      }
//  delay(50);
//}

  currentState1B = digitalRead(encoder1B);
  if (currentState1B != previousState1B) {
    rotaryEncoder1();
  }


  currentState2B = digitalRead(encoder2B);
  if (currentState2B != previousState2B) {
    {
      if (digitalRead(encoder2A) != currentState2B) {
        counter2 --;
      }
      else {
        counter2 ++;
      }
      if (counter2 <= 0) {
        counter2 = 4;
      }
      if (counter2 > 4) {
        counter2 = 0;
      }
      Serial.println(counter2);
      display.ssd1306_command(SSD1306_DISPLAYON);
      previousMillisOLED = currentMillis;
      previousState2B = currentState2B;
    }
  }
  //OLED______________________________________________________________
  //display WORK program____________________________________________
  if (profileGroup == 0) {
    if (counter2 == 0) {
      testdrawbitmap_ARDUINO();
    }
    if (counter2 == 1) {
      testdrawbitmap_POWERPOINT();
    }
    if (counter2 == 2) {
      testdrawbitmap_EXCELL();
    }
    if (counter2 == 3) {
      testdrawbitmap_WORD();
    }
  }
  //display GAME program____________________________________________
  if (profileGroup == 1) {
    if (counter2 == 0) {
      testdrawbitmap_SIFU();
    }
    if (counter2 == 1) {
      testdrawbitmap_VALORANT();
    }
    if (counter2 == 2) {
      testdrawbitmap_FARCRY4();
    }
  }
  //__________________________________________________________________

  //Key profile_______________________________________________________
  //WORK profile______________________________________________________
  if (profileGroup == 0) {
    if (counter2 == 0) {                        //arduino
      if (!digitalRead(red_button)) {
        Keyboard.press(KEY_LEFT_SHIFT);
        Keyboard.press(KEY_LEFT_CTRL);
        Keyboard.press('M');
        Keyboard.releaseAll();
        delay(50);
      }
    }

    if (counter2 == 1) {                        //powerpoint
      if (!digitalRead(red_button)) {
        Keyboard.press(KEY_LEFT_CTRL);
        Keyboard.press(KEY_LEFT_SHIFT);
        Keyboard.press('D');
        Keyboard.releaseAll();
        delay(50);
      }
    }

    if (counter2 == 2) {                        //excell
      if (!digitalRead(red_button)) {
        Keyboard.press(KEY_LEFT_CTRL);
        Keyboard.press(KEY_LEFT_SHIFT);
        Keyboard.press(KEY_DOWN_ARROW);
        Keyboard.releaseAll();
        delay(50);
      }
    }

    if (counter2 == 3) {                        //word
      if (!digitalRead(red_button)) {
        Keyboard.press(KEY_LEFT_CTRL);
        Keyboard.press('S');
        Keyboard.releaseAll();
        delay(50);
      }
    }
  }
  //GAME profile_________________________________________________________
  if (profileGroup == 1) {
    if (counter2 == 0) {                        //sifu
      if (!digitalRead(red_button)) {
        Keyboard.press('W');
        Keyboard.releaseAll();
        Keyboard.press('W');
        Keyboard.releaseAll();
        Mouse.press(MOUSE_LEFT);
        Mouse.release(MOUSE_LEFT);
        delay(50);
      }
    }

    if (counter2 == 1) {                        //valorant
      if (!digitalRead(red_button)) {
        Keyboard.press(KEY_LEFT_SHIFT);
        Keyboard.press(KEY_LEFT_CTRL);
        Keyboard.press('M');
        Keyboard.releaseAll();
        delay(50);
      }
    }

    if (counter2 == 2) {                        //farcry4
      if (!digitalRead(red_button)) {
        Keyboard.press(KEY_LEFT_SHIFT);
        Keyboard.press(KEY_LEFT_CTRL);
        Keyboard.press('M');
        Keyboard.releaseAll();
        delay(50);
      }
    }
  }
}

void rotaryEncoder1() {
  if (digitalRead(encoder1A) != currentState1B) {
    counter1 --;
  }
  else {
    counter1 ++;
  }
  Serial.println(counter1);
  previousState1B = currentState1B;
}

//bitmap function________________________________________________________________________________________________
void testdrawbitmap_ARDUINO(void) {
  display.clearDisplay();
  display.drawBitmap(
    (display.width()  - LOGO_WIDTH ) / 2,
    (display.height() - LOGO_HEIGHT) / 2,
    arduino_logo, LOGO_WIDTH, LOGO_HEIGHT, 1);
  display.display();
}

void testdrawbitmap_WORD(void) {
  display.clearDisplay();
  display.drawBitmap(
    (display.width()  - LOGO_WIDTH ) / 2,
    (display.height() - LOGO_HEIGHT) / 2,
    WORD_logo, LOGO_WIDTH, LOGO_HEIGHT, 1);
  display.display();
}

void testdrawbitmap_EXCELL(void) {
  display.clearDisplay();
  display.drawBitmap(
    (display.width()  - LOGO_WIDTH ) / 2,
    (display.height() - LOGO_HEIGHT) / 2,
    EXCELL_logo, LOGO_WIDTH, LOGO_HEIGHT, 1);
  display.display();
}

void testdrawbitmap_POWERPOINT(void) {
  display.clearDisplay();
  display.drawBitmap(
    (display.width()  - LOGO_WIDTH ) / 2,
    (display.height() - LOGO_HEIGHT) / 2,
    POWERPOINT_logo, LOGO_WIDTH, LOGO_HEIGHT, 1);
  display.display();
}

void testdrawbitmap_SIFU(void) {
  display.clearDisplay();
  display.drawBitmap(
    (display.width()  - LOGO_WIDTH ) / 2,
    (display.height() - LOGO_HEIGHT) / 2,
    sifu_logo, LOGO_WIDTH, LOGO_HEIGHT, 1);
  display.display();
}

void testdrawbitmap_VALORANT(void) {
  display.clearDisplay();
  display.drawBitmap(
    (display.width()  - LOGO_WIDTH ) / 2,
    (display.height() - LOGO_HEIGHT) / 2,
    VALORANT_logo, LOGO_WIDTH, LOGO_HEIGHT, 1);
  display.display();
}

void testdrawbitmap_FARCRY4(void) {
  display.clearDisplay();
  display.drawBitmap(
    (display.width()  - LOGO_WIDTH ) / 2,
    (display.height() - LOGO_HEIGHT) / 2,
    FARCRY4_logo, LOGO_WIDTH, LOGO_HEIGHT, 1);
  display.display();
}
//___________________________________________________________________________________________
